## Documentation/devicetree/bindings/media/apple,isp.yaml
```yaml
# SPDX-License-Identifier: (GPL-2.0-only OR BSD-2-Clause)
%YAML 1.2
---
$id: http://devicetree.org/schemas/media/apple,isp.yaml#
$schema: http://devicetree.org/meta-schemas/core.yaml#

title: An ISP block used in Apple products

maintainers:
  - Sasha Finkelstein <fnkl.kernel@gmail.com>

description:
  The ISP in charge of webcams on ARM Apple laptops. Runs the camera
  itself, and does not need to be linked to any other hardware

properties:
  compatible:
    items:
      - enum:
          - apple,t8103-isp
          - apple,t8112-isp
          - apple,t6000-isp
          - apple,t6020-isp
      - const: apple,isp

  reg:
    items:
      - description: ASC coprocessor control
      - description: Peripheral to host mailbox
      - description: General-purpose ASC IO registers
      - description: Host to peripheral mailbox

  reg-names:
    items:
      - const: coproc
      - const: mbox
      - const: gpio
      - const: mbox2

  iommus:
    description: All 3 must be kept in sync
    maxItems: 3

  interrupts:
    maxItems: 1

  power-domains:
    minItems: 1
    maxItems: 20
    description: All necessary power domains. Driver will enable them in order

  memory-region:
    maxItems: 1

  apple,platform-id:
    description:
      Platform id that is sent to firmware. Closer to a board id than to SoC id,
      except several boards share same platform ids
    $ref: /schemas/types.yaml#/definitions/uint32

  apple,temporal-filter:
    description:
      Whether temporal filter should be enabled in firmware. Support varies
      per-board, not per-SoC
    $ref: /schemas/types.yaml#/definitions/uint32

required:
  - compatible
  - reg
  - iommus
  - interrupts
  - power-domains
  - memory-region
  - apple,platform-id
  - apple,temporal-filter

additionalProperties: false

examples:
  - |
    #include <dt-bindings/interrupt-controller/apple-aic.h>
    isp: isp@2a000000 {
        compatible = "apple,t8103-isp", "apple,isp";
        reg = <0x2a000000 0x2000000>,
              <0x2c104000 0x100>,
              <0x2c104170 0x100>,
              <0x2c1043f0 0x100>;
        reg-names = "coproc", "mbox", "gpio", "mbox2";
        iommus = <&isp_dart0 0>, <&isp_dart1 0>, <&isp_dart2 0>;
        interrupt-parent = <&aic>;
        interrupts = <AIC_IRQ 246 IRQ_TYPE_LEVEL_HIGH>;
        power-domains = <&ps_isp_sys>, <&ps_isp_set0>,
                        <&ps_isp_set1>, <&ps_isp_set2>, <&ps_isp_fe>,
                        <&ps_isp_set4>, <&ps_isp_set5>, <&ps_isp_set6>,
                        <&ps_isp_set7>, <&ps_isp_set8>, <&ps_isp_set9>,
                        <&ps_isp_set10>, <&ps_isp_set11>,
                        <&ps_isp_set12>;
        memory-region = <&isp_heap>;
        apple,platform-id = <1>;
        apple,temporal-filter = <0>;
    };
...
```

## drivers/media/platform/apple/isp/Kconfig
```kconfig
# SPDX-License-Identifier: GPL-2.0-only

config VIDEO_APPLE_ISP
	tristate "Apple Silicon Image Signal Processor driver"
	select VIDEOBUF2_CORE
	select VIDEOBUF2_V4L2
	select VIDEOBUF2_DMA_CONTIG
	depends on ARCH_APPLE || COMPILE_TEST
	depends on V4L_PLATFORM_DRIVERS
	depends on VIDEO_DEV
	help
	  Say Y here to enable support for the ISP and cameras persent
	  in Apple ARM laptops.

	  To compile this driver as a module, choose M here. The module will be
	  called apple_isp
```

## drivers/usb/typec/tipd/Kconfig
```kconfig
config TYPEC_TPS6598X
	tristate "TI TPS6598x USB Power Delivery controller driver"
	depends on I2C
	select POWER_SUPPLY
	select REGMAP_I2C
	select USB_ROLE_SWITCH
	help
	  Say Y or M here if your system has TI TPS65982 or TPS65983 USB Power
	  Delivery controller.

	  If you choose to build this driver as a dynamically linked module, the
	  module will be called tps6598x.ko.

config TYPEC_TPS6598X_SPMI_APPLE
	bool "TI TPS6598x Apple SPMI support"
	depends on TYPEC_TPS6598X
	select REGMAP_SPMI
	help
	  Say Y here to enable support for TPS6598x controllers on a SPMI bus
	  on Apple Silicon.
```
